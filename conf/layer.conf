## conf/layer.conf
```bitbake
# Layer configuration for meta-mender (raspberrypi)
# Copyright 2016 Mender Software AS
# Copyright 2016 Mirza Krak

# We have a conf and classes directory, add to BBPATH
BBPATH .= ":${LAYERDIR}"

# We have recipes-* directories, add to BBFILES
BBFILES += "${LAYERDIR}/recipes-*/*/*.bb \
	${LAYERDIR}/recipes-*/*/*.bbappend"

BBFILE_COLLECTIONS += "mender-demo"
BBFILE_PATTERN_mender-demo = "^${LAYERDIR}/"
BBFILE_PRIORITY_mender-demo = "10"
```
